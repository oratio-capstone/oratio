## fw/sdkconfig.defaults
```kconfig
# Board flash
CONFIG_ESPTOOLPY_FLASHSIZE_8MB=y

# IP forwarding and NAT
CONFIG_LWIP_IP_FORWARD=y
CONFIG_LWIP_IPV4_NAPT=y
CONFIG_LWIP_IPV4_NAPT_PORTMAP=y

# IoT Bridge: Wi-Fi station and SoftAP
CONFIG_BRIDGE_ENABLE=y
CONFIG_BRIDGE_WIFI_PMF_DISABLE=y
CONFIG_BRIDGE_EXTERNAL_NETIF_STATION=y
CONFIG_BRIDGE_STATION_CANCEL_AUTO_CONNECT_WHEN_DISCONNECTED=y
CONFIG_BRIDGE_DATA_FORWARDING_NETIF_SOFTAP=y

# Mesh access point
CONFIG_BRIDGE_SOFTAP_SSID="Oratio"
CONFIG_BRIDGE_SOFTAP_PASSWORD="Capstone"
# CONFIG_BRIDGE_SOFTAP_SSID_END_WITH_THE_MAC is not set
CONFIG_BRIDGE_SOFTAP_MAX_CONNECT_NUMBER=6

# Mesh identity and topology
CONFIG_MESH_LITE_ENABLE=y
CONFIG_MESH_LITE_VENDOR_ID_0=71
CONFIG_MESH_LITE_VENDOR_ID_1=87
CONFIG_MESH_LITE_ID=77
CONFIG_MESH_LITE_MAX_ROUTER_NUMBER=3
CONFIG_MESH_LITE_MAXIMUM_LEVEL_ALLOWED=3
CONFIG_JOIN_MESH_WITHOUT_CONFIGURED_WIFI_INFO=y
CONFIG_JOIN_MESH_IGNORE_ROUTER_STATUS=y
# CONFIG_LEAF_NODE is not set

# Optional mesh features
# CONFIG_MESH_LITE_NODE_INFO_REPORT is not set
# CONFIG_MESH_LITE_PROV_ENABLE is not set
# CONFIG_MESH_LITE_WIRELESS_DEBUG is not set
```

## fw/src/Kconfig.projbuild
```kconfig
menu "Oratio Network Configuration"

    config ORATIO_ROUTER_SSID
        string "Laptop hotspot SSID"
        default ""
        help
            Wi-Fi network name of the laptop hotspot.
            The root node uses this network as its upstream connection.

    config ORATIO_ROUTER_PASSWORD
        string "Laptop hotspot password"
        default ""
        help
            Password for the laptop hotspot.
            This value is stored in plaintext in the generated SDK configuration.

endmenu
```
