## fw/src/Kconfig.projbuild
```kconfig
menu "Oratio Network Configuration"

    config ORATIO_ROUTER_SSID
        string "Laptop hotspot SSID"
        default ""
        help
            Wi-Fi network name of the laptop hotspot.
            The root node uses this network as its upstream connection.

    config ORATIO_ROUTER_PASSWORD
        string "Laptop hotspot password"
        default ""
        help
            Password for the laptop hotspot.
            This value is stored in plaintext in the generated SDK configuration.

    config ORATIO_IS_RELAY
        bool "Fixed relay node"
        default n
        help
            Enable for a stationary non-root relay. Leave disabled for a worker.
            The root always reports relay role regardless of this setting.
            This sets heartbeat identity only; it does not change audio tasks
            or the mesh level selected by the firmware role.

endmenu
```
